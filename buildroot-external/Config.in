## buildroot-external/Config.in
```kconfig
menu "Aaron final project packages"
	source "$BR2_EXTERNAL_AARON_FP_PATH/package/receiver/Config.in"
endmenu
```

## buildroot-external/package/receiver/Config.in
```kconfig
config BR2_PACKAGE_RECEIVER
	bool "receiver"
	depends on BR2_PACKAGE_PYTHON3
	select BR2_PACKAGE_PYTHON_SERIAL
	help
	  Pi4 UART telemetry receiver and logging application
	  for the final project.
```
